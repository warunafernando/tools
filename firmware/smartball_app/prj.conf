## CMakeLists.txt
```
# SmartBall NCS App - BLE baseline (Step 1 of BLE_OTA_upgrade.md)
# Board: xiao_ble (Seeed XIAO nRF52840 Sense)
cmake_minimum_required(VERSION 3.20.0)
find_package(Zephyr REQUIRED HINTS $ENV{ZEPHYR_BASE})
project(smartball_app)

target_sources(app PRIVATE src/main.c)
```

## sysbuild.conf
```
# Sysbuild: MCUboot + SmartBall app
# Enables A/B slots and rollback (BLE_OTA_upgrade.md §2, §3)

# Enable MCUboot as bootloader
SB_CONFIG_BOOTLOADER_MCUBOOT=y
```

## prj.conf
```kconfig
# SmartBall NCS App - BLE + mcumgr SMP + health-gated confirm
# Board: xiao_ble (Seeed XIAO nRF52840 Sense)
# BLE_OTA_upgrade.md steps 1-6

CONFIG_BT=y
CONFIG_BT_PERIPHERAL=y
CONFIG_BT_DEVICE_NAME="SmartBall"
CONFIG_BT_DEVICE_APPEARANCE=833
CONFIG_BT_DIS=y
CONFIG_BT_ATT_PREPARE_COUNT=5

# BLE tuning for OTA (BLE_OTA_upgrade.md §5.2)
CONFIG_BT_BUF_ACL_TX_SIZE=251
CONFIG_BT_CTLR_DATA_LENGTH_MAX=251
CONFIG_BT_L2CAP_TX_MTU=247

# mcumgr SMP over BLE (§5.1)
CONFIG_MCUMGR=y
CONFIG_MCUMGR_GRP_IMG=y
CONFIG_MCUMGR_GRP_OS=y
CONFIG_MCUMGR_TRANSPORT_BT=y
CONFIG_MCUMGR_TRANSPORT_BT_REASSEMBLY=y
CONFIG_MCUMGR_TRANSPORT_BT_PERM_RW_ENCRYPT=n

# Settings/NVS for persistent state (§6, §7)
CONFIG_FLASH=y
CONFIG_FLASH_MAP=y
CONFIG_NVS=y
CONFIG_SETTINGS=y
CONFIG_SETTINGS_NVS=y

# Bootloader (when built standalone without sysbuild, use overlay)
# CONFIG_BOOTLOADER_MCUBOOT=y

CONFIG_LOG=y
CONFIG_BOOT_BANNER=n
```

## src/main.c
```c
/*
 * SmartBall NCS App - BLE + mcumgr SMP + health-gated confirm + DFU-safe mode
 * BLE_OTA_upgrade.md steps 1-6
 * Board: xiao_ble (Seeed XIAO nRF52840 Sense)
 */
#include <zephyr/kernel.h>
#include <zephyr/bluetooth/bluetooth.h>
#include <zephyr/bluetooth/conn.h>
#include <zephyr/bluetooth/gap.h>
#include <zephyr/settings/settings.h>
#include <zephyr/dfu/mcuboot.h>
#include <zephyr/sys/reboot.h>
#include <stdio.h>

#define N_FAIL_MAX 3
#define T_CONFIRM_WINDOW_SEC 30
#define BATTERY_THRESHOLD_MV 3700

/* Boot count stored via settings (key: boot/count) */
#define SETTINGS_BOOT_COUNT_KEY "boot/cnt"
static uint32_t boot_count;
static bool dfu_safe_mode;
static bool health_ok;

static void connected(struct bt_conn *conn, uint8_t err)
{
	if (err) {
		printk("Connection failed (err 0x%02x)\n", err);
	} else {
		printk("Connected\n");
	}
}

static void disconnected(struct bt_conn *conn, uint8_t reason)
{
	printk("Disconnected (reason 0x%02x)\n", reason);
}

BT_CONN_CB_DEFINE(conn_callbacks) = {
	.connected = connected,
	.disconnected = disconnected,
};

static const struct bt_data ad[] = {
	BT_DATA_BYTES(BT_DATA_FLAGS, (BT_LE_AD_GENERAL | BT_LE_AD_NO_BREDR)),
	BT_DATA_BYTES(BT_DATA_UUID16_ALL, BT_UUID_DIS_VAL),
};

static const struct bt_data sd[] = {
	BT_DATA(BT_DATA_NAME_COMPLETE, CONFIG_BT_DEVICE_NAME, sizeof(CONFIG_BT_DEVICE_NAME) - 1),
};

/* Boot failure counter (§7.1) - uses settings (load done after bt_ready) */
static void boot_counter_increment(void)
{
	boot_count++;
}

static void boot_counter_clear(void)
{
	boot_count = 0;
}

/* Load boot count from settings - call after settings_load() */
static void boot_counter_load_from_settings(void)
{
	char buf[12];
	size_t len = sizeof(buf);
	if (settings_get(SETTINGS_BOOT_COUNT_KEY, buf, &len) == 0 && len > 0) {
		boot_count = (uint32_t)strtoul(buf, NULL, 10);
	}
}

static void boot_counter_save(void)
{
	char buf[12];
	snprintf(buf, sizeof(buf), "%u", boot_count);
	settings_save_one(SETTINGS_BOOT_COUNT_KEY, buf);
}

/* Health checks (§6.1) - minimal: BLE + stub battery/sensors */
static bool run_health_checks(void)
{
	/* BLE: already initialized and advertising */
	/* Battery: stub - in production use ADC. Assume OK for now */
	(void)BATTERY_THRESHOLD_MV;
	/* Sensors: stub - in production init IMU. Assume OK for now */
	return true;
}

static void bt_ready(int err)
{
	if (err) {
		printk("Bluetooth init failed (err %d)\n", err);
		return;
	}
	printk("Bluetooth initialized\n");

	if (IS_ENABLED(CONFIG_SETTINGS)) {
		settings_load();
	}

	err = bt_le_adv_start(BT_LE_ADV_CONN_FAST_1, ad, ARRAY_SIZE(ad), sd, ARRAY_SIZE(sd));
	if (err) {
		printk("Advertising failed to start (err %d)\n", err);
		return;
	}
	printk("Advertising started as '%s'\n", CONFIG_BT_DEVICE_NAME);
}

int main(void)
{
	int err;
	uint32_t confirm_deadline;
	bool pending_confirm = false;

	if (IS_ENABLED(CONFIG_SETTINGS)) {
		settings_subsys_init();
		settings_load();
		boot_counter_load_from_settings();
	}
	boot_counter_increment();
	boot_counter_save();

	/* DFU-safe mode (§7.2): if boot failures exceed N_FAIL_MAX */
	if (boot_count >= N_FAIL_MAX) {
		dfu_safe_mode = true;
		printk("DFU-safe mode: boot_count=%u >= %d\n", boot_count, N_FAIL_MAX);
	}

	err = bt_enable(bt_ready);
	if (err) {
		printk("bt_enable failed (err %d)\n", err);
		return 0;
	}

	/* Check if we are in test (pending confirm) state (§6.2) */
	if (boot_is_img_confirmed()) {
		boot_counter_clear();
		boot_counter_save();
	} else {
		pending_confirm = true;
		confirm_deadline = k_uptime_get_32() + (T_CONFIRM_WINDOW_SEC * 1000);
		printk("Image in TEST state - health check window %ds\n", T_CONFIRM_WINDOW_SEC);
	}

	/* Main loop: run health checks and confirm when ready */
	for (;;) {
		k_sleep(K_SECONDS(1));

		if (pending_confirm && k_uptime_get_32() < confirm_deadline) {
			health_ok = run_health_checks();
			if (health_ok) {
				err = boot_write_img_confirmed();
				if (err == 0) {
					printk("Image confirmed\n");
					pending_confirm = false;
					boot_counter_clear();
					boot_counter_save();
				} else {
					printk("boot_write_img_confirmed failed %d\n", err);
				}
			}
		}

		if (pending_confirm && k_uptime_get_32() >= confirm_deadline) {
			printk("Health check window expired without confirm - rollback on next reboot\n");
			pending_confirm = false;
		}
	}
	return 0;
}
```
